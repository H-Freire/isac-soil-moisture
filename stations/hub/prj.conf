## CMakeLists.txt
```
# SPDX-FileCopyrightText: 2026 Henrique Freire <hfreire10@hotmail.com>

# SPDX-License-Identifier: MIT

cmake_minimum_required(VERSION 3.20.0)

list(APPEND EXTRA_ZEPHYR_MODULES ${CMAKE_CURRENT_LIST_DIR}/../../modules/wifi_sensing)

find_package(Zephyr REQUIRED HINTS $ENV{ZEPHYR_BASE})
project(hub)

target_sources(app PRIVATE
  src/lora.c
  src/main.c
  src/server.c
)
target_include_directories(app PRIVATE include)

set(gen_dir ${ZEPHYR_BINARY_DIR}/include/generated/)

generate_inc_file_for_target(app src/gts_root_r4.pem
                                 ${gen_dir}/google_root_ca.inc)
```

## Kconfig
```
# SPDX-FileCopyrightText: 2026 Henrique Freire <hfreire10@hotmail.com>

# SPDX-License-Identifier: MIT

menu "Hub"

config SERVER_SECRET
    string "Server API key"
    help
      Secret API key for HTTP POST on server.

config SERVER_URL
    string "Server URL"
    help
      Server path (macros/s/<script_id>/exec for Google Apps Script).

config SERVER_HOST
    string "Server domain"
    default "script.google.com"
    help
      Server domain.

endmenu

source "Kconfig.zephyr"
```

## prj.conf
```kconfig
# SPDX-FileCopyrightText: 2026 Henrique Freire <hfreire10@hotmail.com>
#
# SPDX-License-Identifier: MIT

# Debug
CONFIG_LOG=y
CONFIG_THREAD_NAME=y
CONFIG_STACK_CANARIES=y
CONFIG_STACK_SENTINEL=y

# General
CONFIG_SPI=y
CONFIG_GPIO=y
CONFIG_FLASH=y
CONFIG_EVENTS=y
CONFIG_MAIN_STACK_SIZE=1548
CONFIG_IDLE_STACK_SIZE=256
CONFIG_ISR_STACK_SIZE=1024
CONFIG_HEAP_MEM_POOL_SIZE=62624

# FUOTA
#CONFIG_COAP=y
#CONFIG_REBOOT=y
#CONFIG_HWINFO=y
#CONFIG_FLASH_MAP=y
#CONFIG_STREAM_FLASH=y
#CONFIG_IMG_MANAGER=y
#CONFIG_JSON_LIBRARY=y
#CONFIG_BOOTLOADER_MCUBOOT=y

# Networking
CONFIG_BASE64=y
CONFIG_NET_TCP=y
CONFIG_NET_IPV4=y
CONFIG_POSIX_API=y
CONFIG_NET_DHCPV4=y
CONFIG_NETWORKING=y
CONFIG_NET_SOCKETS=y
CONFIG_HTTP_CLIENT=y
CONFIG_DNS_RESOLVER=y
CONFIG_NET_PKT_RX_COUNT=10
CONFIG_NET_PKT_TX_COUNT=20
CONFIG_NET_BUF_RX_COUNT=20
CONFIG_NET_BUF_TX_COUNT=20
CONFIG_NET_TX_STACK_SIZE=2048

## TLS
CONFIG_MBEDTLS=y
CONFIG_TLS_CREDENTIALS=y
CONFIG_MBEDTLS_ENABLE_HEAP=y
CONFIG_MBEDTLS_HEAP_SIZE=68500
CONFIG_NET_SOCKETS_SOCKOPT_TLS=y
CONFIG_MBEDTLS_SSL_IN_CONTENT_LEN=16384
CONFIG_MBEDTLS_SSL_OUT_CONTENT_LEN=16384
CONFIG_PSA_WANT_ALG_SHA_384=y
CONFIG_PSA_WANT_ECC_SECP_R1_384=y

## WiFi
CONFIG_WIFI=y
CONFIG_WIFI_ESP32=y
CONFIG_NET_L2_WIFI_MGMT=y
CONFIG_WIFI_USAGE_MODE_STA=y
CONFIG_ESP32_WIFI_IRAM_OPT=y
CONFIG_ESP32_WIFI_ENTERPRISE=y
CONFIG_ESP32_WIFI_RX_IRAM_OPT=y
CONFIG_ESP32_WIFI_STA_RECONNECT=y

## Wi-Fi sensing module
CONFIG_WIFI_CHANNEL=0
CONFIG_WIFI_SSID="eduroam"
CONFIG_WIFI_WPA_ENTERPRISE=y

## LoRa
CONFIG_LORA=y
```

## secrets-example.conf
```kconfig
# SPDX-FileCopyrightText: 2026 Henrique Freire <hfreire10@hotmail.com>

# SPDX-License-Identifier: MIT

# Wi-Fi credentials
CONFIG_WIFI_EAP_ID=
CONFIG_WIFI_EAP_PASSWD=

# Google Apps Script
CONFIG_SERVER_URL=
CONFIG_SERVER_HOST=
CONFIG_SERVER_SECRET=

# UpdateHub access
CONFIG_UPDATEHUB_PRODUCT_UID=
```

## src/main.c
```c
// SPDX-FileCopyrightText: 2026 Henrique Freire <hfreire10@hotmail.com>
//
// SPDX-License-Identifier: MIT

#include <zephyr/device.h>
#include <zephyr/drivers/lora.h>
#include <zephyr/kernel.h>
#include <zephyr/logging/log.h>
#include <zephyr/net/http/client.h>

#include <lora.h>
#include <wifi_sensing.h>

#include "hub.h"

LOG_MODULE_REGISTER(hub);

const struct device *g_lora_dev = DEVICE_DT_GET(LORA_NODE);

size_t g_sensor_msg_count, g_csi_msg_count;
uint8_t g_csi_msg_buf[MAX_MSGS][CSI_MSG_SIZE] __attribute__((section(".noinit.buf")));
uint8_t g_sensor_msg_buf[MAX_DEVICES][SENSOR_MSG_SIZE] __attribute__((section(".noinit.buf")));

K_SEM_DEFINE(g_google_sem, 0, 1);

int main(void) {
  LOG_INF("Starting hub");

  net_register(NULL);

  ap_connect(NULL);
  lora_init(g_lora_dev, false);

  create_server_thread();
}
```

## include/ca_certificate.h
```c
// SPDX-FileCopyrightText: 2026 Henrique Freire <hfreire10@hotmail.com>

// SPDX-License-Identifier: MIT

#pragma once

#define TLS_CA_TAG  1
#define SERVER_HOST "script.google.com"

const unsigned char g_google_ca[] = {
#include "google_root_ca.inc"
    0x00,
};
```

## include/hub.h
```c
// SPDX-FileCopyrightText: 2026 Henrique Freire <hfreire10@hotmail.com>

// SPDX-License-Identifier: MIT

#pragma once

#include <inttypes.h>

#include <lora.h>

#define LORA_NODE DT_ALIAS(lora0)

void create_server_thread(void);

extern const struct device *g_lora_dev;

// server_tx_thread
extern struct k_sem g_google_sem;
extern size_t g_sensor_msg_count, g_csi_msg_count;
extern uint8_t g_csi_msg_buf[MAX_MSGS][CSI_MSG_SIZE];
extern uint8_t g_sensor_msg_buf[MAX_DEVICES][SENSOR_MSG_SIZE];
```

## src/lora.c
```c
// SPDX-FileCopyrightText: 2026 Henrique Freire <hfreire10@hotmail.com>

// SPDX-License-Identifier: MIT

#include <inttypes.h>

#include <zephyr/drivers/lora.h>
#include <zephyr/kernel.h>
#include <zephyr/logging/log.h>

#include <lora.h>

#include "hub.h"

#define LORA_RX_PRIORITY   4
#define LORA_RX_STACK_SIZE 1000

BUILD_ASSERT(DT_NODE_HAS_STATUS_OKAY(LORA_NODE), "No default LoRa radio specified in DT");

LOG_MODULE_DECLARE(hub);

static void lora_rx_thread(void *p1, void *p2, void *p3);

K_THREAD_DEFINE(lora_rx_tid, LORA_RX_STACK_SIZE, lora_rx_thread, NULL, NULL, NULL, LORA_RX_PRIORITY,
                0, 0);

static void lora_rx_thread(void *p1 __unused, void *p2 __unused, void *p3 __unused) {
  int8_t snr;
  int16_t rssi;

  k_event_wait(&g_net_events, NET_READY, false, K_FOREVER);

  while (true) {
    // Unset deadline
    k_timepoint_t deadline = sys_timepoint_calc(K_FOREVER);

    lora_data_t *pkt;
    size_t csi_msg_count    = 0;
    size_t sensor_msg_count = 0;

    {
      size_t i;
      k_timeout_t timeout;
      for (i = 0, timeout = K_FOREVER; i < MAX_MSGS && !K_TIMEOUT_EQ(timeout, K_NO_WAIT);
           i++, timeout   = sys_timepoint_timeout(deadline)) {
        pkt = (lora_data_t *)&g_csi_msg_buf[i];

        int len = lora_recv(g_lora_dev, (uint8_t *)pkt, sizeof(*pkt), timeout, &rssi, &snr);

        if (len < 0) {
          LOG_ERR("LoRa recv failed (%d)", len);
          continue;
        }

        if (pkt->hdr.magic != LORA_MAGIC) {
          LOG_ERR("LoRa message not intended for device");
          continue;
        }

        switch (pkt->hdr.id) {
        case LORA_DATA_ID: {
          if (!i) {
            // Set deadline after first valid message received
            deadline = sys_timepoint_calc(K_SECONDS(SENSING_INTERVAL_SEC - 120));
          }

          if (pkt->hdr.type == MSG_ID_SENSORS) {
            static size_t s_sensor_msg_idx;

            memcpy(&g_sensor_msg_buf[s_sensor_msg_idx], (uint8_t *)pkt, SENSOR_MSG_SIZE);
            s_sensor_msg_idx =
                (s_sensor_msg_idx + 1) % (sizeof(g_sensor_msg_buf) / sizeof(g_sensor_msg_buf[0]));

            i--;
            sensor_msg_count++;
          } else { // MSG_ID_CSI
            csi_msg_count++;
          }
          break;
        }
        case LORA_ACK_REQ_ID:
        default:
          break;
        }

        LOG_DBG("LoRa RX len: %d, RSSI: %d dBm, SNR: %d db", len, rssi, snr);
        LOG_HEXDUMP_DBG(&pkt->payload, len, "Sensor msg payload");
      }
    }

    g_csi_msg_count    = csi_msg_count;
    g_sensor_msg_count = sensor_msg_count;
    k_sem_give(&g_google_sem);
  }
}
```

## src/server.c
```c
// SPDX-FileCopyrightText: 2026 Henrique Freire <hfreire10@hotmail.com>
//
// SPDX-License-Identifier: MIT

#include <zephyr/device.h>
#include <zephyr/kernel.h>
#include <zephyr/kernel/thread_stack.h>
#include <zephyr/logging/log.h>
#include <zephyr/net/http/client.h>
#include <zephyr/net/socket.h>
#include <zephyr/net/tls_credentials.h>
#include <zephyr/posix/arpa/inet.h>
#include <zephyr/posix/netdb.h>
#include <zephyr/posix/sys/socket.h>
#include <zephyr/posix/unistd.h>
#include <zephyr/sys/base64.h>
#include <zephyr/sys/util.h>

#include "ca_certificate.h"
#include "hub.h"
#include "wifi_sensing.h"

#define SERVER_TX_PRIORITY   5
#define SERVER_TX_STACK_SIZE 4096

#define HTTPS_PORT 443

#define CONTENT_TYPE      "text/plain"
#define RESPONSE_BUF_SIZE 32

#define BASE64_IN_SIZE  384
#define BASE64_OUT_SIZE ROUND_UP(4 * BASE64_IN_SIZE / 3, 4)

typedef struct {
  const uint8_t *data;
  size_t len;
} upload_ctx_t;

LOG_MODULE_DECLARE(hub);

static void server_tx_thread(void *p1, void *p2, void *p3);

static struct k_thread s_server_tx_thread;

struct z_thread_stack_element __attribute__((section(".bss")))
__aligned(ARCH_THREAD_STACK_OBJ_ALIGN(ARCH_THREAD_STACK_SIZE_ADJUST((SERVER_TX_STACK_SIZE) +
                                                                    K_THREAD_STACK_RESERVED)))
    server_tx_stack[K_THREAD_STACK_LEN(SERVER_TX_STACK_SIZE)];

void create_server_thread(void) {
  k_thread_create(&s_server_tx_thread, server_tx_stack, K_THREAD_STACK_SIZEOF(server_tx_stack),
                  server_tx_thread, NULL, NULL, NULL, SERVER_TX_PRIORITY, 0, K_NO_WAIT);
}

static int http_response_cb(struct http_response *rsp, enum http_final_call final_data,
                            void *user_data) {
  LOG_INF("HTTP status: %u (%s)", rsp->http_status_code, rsp->http_status);

  /*
    static int response_len;
    static char response_buf[RESPONSE_BUF_SIZE];

    if (rsp->body_found && rsp->body_frag_len > 0) {
    size_t copy = MIN(rsp->body_frag_len, RESPONSE_BUF_SIZE - response_len - 1);
    memcpy(&response_buf[response_len], rsp->body_frag_start, copy);

    response_len += copy;
    response_buf[response_len] = '\0';
  }

  if (final_data == HTTP_DATA_FINAL) {
    LOG_DBG("HTTP response: %s", response_buf);

    if (!strcmp(response_buf, "OK")) {
      LOG_INF("Data upload successful");
    } else {
      LOG_ERR("Upload failed: %s", response_buf);
    }

    response_len = 0;
  }*/

  return 0;
}

static int payload_cb(int sock, struct http_request *req __unused, void *user_data) {
  // Zephyr's Base64 encoding uses NULL-terminated strings
  uint8_t encoded[BASE64_OUT_SIZE + 1U];

  size_t total_sent   = 0;
  size_t input_offset = 0;
  upload_ctx_t *ctx   = (upload_ctx_t *)user_data;

  if (ctx == NULL || (ctx->data == NULL && ctx->len != 0)) {
    return -EINVAL;
  }

  size_t encoded_len;
  while (input_offset < ctx->len) {
    size_t sent_offset = 0;
    size_t input_len   = MIN(ctx->len - input_offset, BASE64_IN_SIZE);

    int ret =
        base64_encode(encoded, sizeof(encoded), &encoded_len, ctx->data + input_offset, input_len);

    if (ret < 0) {
      LOG_ERR("Insufficient memory for Base64 encoding");
      return ret;
    }

    while (sent_offset < encoded_len) {
      ssize_t sent = send(sock, encoded + sent_offset, encoded_len - sent_offset, 0);

      if (sent < 0) {
        LOG_ERR("Failed to send with socket (%d)", -errno);
        return -errno;
      }

      sent_offset += (size_t)sent;
      total_sent += (size_t)sent;
    }

    input_offset += input_len;
  }

  return (int)total_sent;
}

static int server_upload_data(int sock, const uint8_t *data, const size_t len) {
  static uint8_t recv_buf[512];
  static const char *const headers[] = {
      "Content-Type: " CONTENT_TYPE "\r\n",
      NULL,
  };

  upload_ctx_t ctx = {
      .data = data,
      .len  = len,
  };

  if (!len) {
    return 0;
  }

  struct http_request req = {
      .method        = HTTP_POST,
      .host          = SERVER_HOST,
      .url           = CONFIG_SERVER_URL "?api-key=" CONFIG_SERVER_SECRET,
      .protocol      = "HTTP/1.1",
      .header_fields = headers,
      .payload_cb    = payload_cb,
      .payload_len   = ROUND_UP(4 * len / 3, 4),
      .recv_buf      = recv_buf,
      .recv_buf_len  = sizeof(recv_buf),
      .response      = http_response_cb,
  };

  // Wait 10 seconds (10_000 milliseconds) for response
  return http_client_req(sock, &req, 1000 * SENSING_INTERVAL_SEC / 2, &ctx);
}

static void server_tx_thread(void *p1 __unused, void *p2 __unused, void *p3 __unused) {
  int ret = tls_credential_add(TLS_CA_TAG, TLS_CREDENTIAL_CA_CERTIFICATE, g_google_ca,
                               sizeof(g_google_ca));
  if (ret < 0) {
    LOG_ERR("Add TLS credential failed (%d)", ret);
  }

  k_event_wait(&g_net_events, NET_READY, false, K_FOREVER);

  int sock = socket(AF_INET, SOCK_STREAM, IPPROTO_TLS_1_2);
  if (sock < 0) {
    LOG_ERR("Failed to create sock (%d)", -errno);
  }

  const sec_tag_t sec_tags[] = {
      TLS_CA_TAG,
  };
  if (setsockopt(sock, SOL_TLS, TLS_SEC_TAG_LIST, sec_tags, sizeof(sec_tags)) < 0) {
    LOG_ERR("Failed to set TLS_SEC_TAG_LIST (%d)", -errno);
    close(sock);
  }

  if (setsockopt(sock, SOL_TLS, TLS_HOSTNAME, SERVER_HOST, strlen(SERVER_HOST)) < 0) {
    LOG_ERR("Failed to set TLS_HOSTNAME (%d)", -errno);
    close(sock);
  }

  {
    struct addrinfo hints = {
        .ai_family   = AF_INET,
        .ai_socktype = SOCK_STREAM,
    };

    struct addrinfo *results;
    int ret = getaddrinfo(SERVER_HOST, NULL, &hints, &results);
    if (ret) {
      LOG_ERR("Failed to resolve host (%d)", ret == EAI_SYSTEM ? -errno : ret);
      close(sock);
    }

    struct sockaddr_in addr = {
        .sin_family = AF_INET,
        .sin_port   = htons(HTTPS_PORT),
        .sin_addr   = ((struct sockaddr_in *)results->ai_addr)->sin_addr,
    };

    freeaddrinfo(results);

    if (connect(sock, (struct sockaddr *)&addr, sizeof(addr)) < 0) {
      LOG_ERR("Failed to connect sock (%d)", -errno);
      close(sock);
    }
  }

  while (true) {
    if (k_sem_take(&g_google_sem, K_FOREVER)) {
      continue;
    }

    LOG_INF("Sem given");

    ret = server_upload_data(sock, (uint8_t *)g_csi_msg_buf,
                             g_csi_msg_count * sizeof(g_csi_msg_buf[0]));
    if (ret < 0) {
      LOG_ERR("CSI - No response from Google Apps Script (%d)", ret);
    } else {
      LOG_INF("CSI - Sent %d bytes to Google Apps Script", ret);
    }

    ret = server_upload_data(sock, (uint8_t *)g_sensor_msg_buf,
                             g_sensor_msg_count * (LORA_HDR_SIZE + 8 + SENSOR_DATA_SIZE));
    if (ret < 0) {
      LOG_ERR("Sensor - No response from Google Apps Script (%d)", ret);
    } else {
      LOG_INF("Sensor - Sent %d bytes to Google Apps Script", ret);
    }
  }
}
```
